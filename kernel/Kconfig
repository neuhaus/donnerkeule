## kernel/Kconfig
```kconfig
# SPDX-License-Identifier: GPL-2.0

config THUNDERBOLT_IBVERBS
	tristate "Thunderbolt/USB4 host-to-host RDMA verbs"
	depends on CONFIGFS_FS && INFINIBAND && THUNDERBOLT
	help
	  Expose Thunderbolt/USB4 host-to-host DMA paths as an RDMA verbs
	  device using the native Linux-to-Linux protocol.

	  This tree is the release-track rewrite. Experimental hardware
	  probing and debug-only modes should stay out of this driver.
```
